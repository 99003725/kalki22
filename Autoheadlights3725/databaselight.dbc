VERSION ""

NS_ :

BS_:

BU_:

BO_ 3221225472 VECTOR__INDEPENDENT_SIG_MSG: 0 Vector__XXX
 SG_ lights_on_off : 0|2@1+ (1,0) [0|2] "Boolean" Vector__XXX

BO_ 304 Auto_on: 1 Vector__XXX
 SG_ auto_on : 0|1@1+ (1,0) [0|1] "Boolean" Vector__XXX

BO_ 288 lights_on_off: 1 Vector__XXX
 SG_ lights_on_off : 0|2@1+ (1,0) [0|2] "Boolean" Vector__XXX

EV_ sensevar: 1 [0|5.5] "volts" 0 1 DUMMY_NODE_VECTOR0 Vector__XXX;

CM_ BO_ 3221225472 "This is a message for not used signals, created by Vector CANdb++ DBC OLE DB Provider.";
